## conf/layer.conf
```bitbake
# We have a conf and classes directory, add to BBPATH
BBPATH .= ":${LAYERDIR}"

# We have a packages directory, add to BBFILES
BBFILES += "${LAYERDIR}/recipes-*/*/*.bb"
BBFILES += "${LAYERDIR}/recipes-*/*/*.bbappend"

BBFILE_COLLECTIONS += "artyz7"
BBFILE_PATTERN_artyz7 = "^${LAYERDIR}/"
BBFILE_PRIORITY_artyz7 = "5"

LAYERDEPENDS_artyz7 = "core"

LAYERSERIES_COMPAT_artyz7 = "rocko thud"
```

## conf/machine/arty-zynq7.conf
```bitbake
#@TYPE: Machine
#@NAME: arty-zynq7
#@DESCRIPTION: Machine support for Arty-Z7 board
#

SOC_VARIANT ?= "7z"

require conf/machine/include/soc-zynq.inc
require conf/machine/include/machine-xilinx-default.inc

MACHINE_FEATURES = "ext2 vfat usbhost usbgadget"

MACHINE_ESSENTIAL_EXTRA_RDEPENDS += "device-tree"

# u-boot configuration
PREFERRED_PROVIDER_virtual/bootloader = "u-boot-digilent"
UBOOT_MACHINE = "zynq_artyz7_defconfig"
SPL_BINARY = "spl/boot.bin"

EXTRA_IMAGEDEPENDS += " \
    u-boot-zynq-uenv \
    virtual/bootloader \
    ${@ 'virtual/bitstream' if d.getVar('VIRTUAL_BITSTREAM') else ''} \
    "

WKS_FILE ?= "sdimage-bootpart.wks"

IMAGE_BOOT_FILES += " \
    boot.bin \
    uEnv.txt \
    arty-zynq7-system.dtb \
    ${@ 'bitstream' if d.getVar('VIRTUAL_BITSTREAM') else ''} \
    "

IMAGE_FSTYPES += "wic tar.bz2"

SERIAL_CONSOLES = "115200;ttyPS0"
```
